## conf/layer.conf
```bitbake
# It really depends on order of the layers appearing in BBLAYERS
# variable in toplevel bblayers.conf file, where bitbake will search
# for .inc files and others where bitbake uses BBPATH since it will
# search the directories from first to last as specified in BBPATH
# Therefore if you want a given layer to be considered high priority
# for the .inc and .conf etc. then consider it adding at the beginning
# of BBPATH. For bblayers bitbake will use BBFILES_PRIORITY to resolve
# the recipe contention so the order of directories in BBFILES does
# not matter.

# We have a conf and classes directory, append to BBPATH
BBPATH .= ":${LAYERDIR}"

# We have a recipes directory, add to BBFILES
BBFILES += "${LAYERDIR}/recipes-*/*/*.bb ${LAYERDIR}/recipes-*/*/*.bbappend"

BBFILE_COLLECTIONS += "openrc-layer"
BBFILE_PATTERN_openrc-layer := "^${LAYERDIR}/"

# Define the priority for recipes (.bb files) from this layer,
# choosing carefully how this layer interacts with all of the
# other layers.

BBFILE_PRIORITY_openrc-layer = "7"

OPENRC_INITDIR = "${sysconfdir}/openrc.d"
OPENRC_CONFDIR = "${sysconfdir}/conf.d"

SIGGEN_EXCLUDERECIPES_ABISAFE += " \
    openrc-scripts \
"

# Stop sysvinit-inittab from modifying inittab
SERIAL_CONSOLES_CHECK=""

# Getty program to use for VTs and serial consoles
OPENRC_GETTY ?= "${base_sbindir}/agetty"

# List of virtual terminals to enable, ex "1 2 3"
OPENRC_VTS ?= ""
# Additional arguments to pass to the getty application
OPENRC_VT_GETTY_ARGS ?= "38400"

# List of serial devices that should run a getty, ex "ttyS0 ttyS1"
OPENRC_SERIAL_CONSOLES ?= ""
# Additional arguments to pass to the getty application
OPENRC_SERIAL_CONSOLE_GETTY_ARGS ?= "-8 -L 115200"

LAYERSERIES_COMPAT_openrc-layer = "thud"
```
